## firmware/Kconfig.projbuild
```kconfig
menu "Spar 7 rewired configuration"

    menu "COMMS"
        source "main/Kconfig.comms"
    endmenu

endmenu
```

## firmware/kconfig.projbuild
```kconfig
menu "Spool Controller Configuration"

    menu "Modbus"
        source "components/modbus/Kconfig.modbus"
    endmenu

endmenu
```

## firmware/main/Kconfig.projbuild
```kconfig
# Kconfig file for Pill COMMS 

menu "COMMS configuration"
    menu "Log levels"
        config COMMS_LOG_LEVEL
            int "COMM log level (0: None, 1: Error, 2: Warning, 3: Info, 4: Debug, 5: Verbose)"
            range 0 5
            default 3
        config COMMS_MODEM_LOG_LEVEL
            int "Modem log level (0: None, 1: Error, 2: Warning, 3: Info, 4: Debug, 5: Verbose)"
            range 0 5
            default 3
        config COMMS_WIFI_LOG_LEVEL
            int "Wifi log level (0: None, 1: Error, 2: Warning, 3: Info, 4: Debug, 5: Verbose)"
            range 0 5
            default 3
        config COMMS_COAP_LOG_LEVEL
            int "COAP log level (0: None, 1: Error, 2: Warning, 3: Info, 4: Debug, 5: Verbose)"
            range 0 5
            default 3
        config MESSAGES_LOG_LEVEL
            int "MESSAGES log level (0: None, 1: Error, 2: Warning, 3: Info, 4: Debug, 5: Verbose)"
            range 0 5
            default 3
    endmenu

    config ESP_MAXIMUM_WIFI_RETRY
        int "Maximum wifi retry"
        default 5
        help
            Set the Maximum retry to avoid station reconnecting to the AP unlimited when the AP is really inexistent.

    choice ESP_WIFI_SCAN_AUTH_MODE_THRESHOLD
        prompt "WiFi Scan auth mode threshold"
        default ESP_WIFI_AUTH_OPEN
        help
            The weakest authmode to accept in the scan mode.

        config ESP_WIFI_AUTH_OPEN
            bool "OPEN"
        config ESP_WIFI_AUTH_WEP
            bool "WEP"
        config ESP_WIFI_AUTH_WPA_PSK
            bool "WPA PSK"
        config ESP_WIFI_AUTH_WPA2_PSK
            bool "WPA2 PSK"
        config ESP_WIFI_AUTH_WPA_WPA2_PSK
            bool "WPA/WPA2 PSK"
        config ESP_WIFI_AUTH_WPA3_PSK
            bool "WPA3 PSK"
        config ESP_WIFI_AUTH_WPA2_WPA3_PSK
            bool "WPA2/WPA3 PSK"
        config ESP_WIFI_AUTH_WAPI_PSK
            bool "WAPI PSK"
    endchoice
endmenu
```
